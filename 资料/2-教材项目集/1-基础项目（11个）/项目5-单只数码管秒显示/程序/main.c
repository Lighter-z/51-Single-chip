//数码管显示0-9秒，针对教材设计
//数码管按秒显示0-9
//设计：单片机创新工作室--齐霄涵设计，2015年12月15日
#include<reg51.h>
code unsigned char seven_seg[10] = {0xc0,0xf9,0xa4,0xb0,0x99,0x92,0x82,0xf8,0x80,0x90};	//数字0~9的显示方法
unsigned char cp,i;																		//全局变量
/*timer0中断服务函数*/
void timer0_isr()interrupt 1															//timer0中断服务函数
{
	TH0 = (65536-5000)/256;																//TH0重置函数
	TL0 = (65536-5000)%256;																//TL0重置函数
	cp++;																				//每次触发中断cp加1
	if(cp >= 200)																		//200次中断    1秒
	{cp = 0;i++;}
	if(i >= 10)i = 0;
	P0 = seven_seg[i];
}
void timer0_init()																		//中断初始化函数
{
	TMOD = 0X01;																		//设置计时器模式控制寄存器，time0工作在定时方式1
	TH0 = (65536-5000)/256;																//TH0 预置，65536十六进制高8位。
	TL0 = (65536-5000)%256;																//TL0 预置，65536十六进制低8位。
	EA = 1;																				//开总中断
	TR0 = 1;																			//启动定时器T0，对机器脉冲计数5000个计满溢出引发中断  约0.5ms
	ET0 = 1;																			//开T0中断
}
void main()
{	
	timer0_init();																		//timer_0初始化,为中断做好准备
	P2 = 0;																				//采用共阳极数码管，共阳极与P2.0之间有反相器，需要设置P2.0 = 0
	while(1);																			//等待中断
} 