//LED点阵驱动，针对B105型实验开发板设计
//通过LED点阵显示简单的字符
//设计：单片机创新工作室--王曙光设计，2015年12月15日
#include<reg51.h>
#include<hc595.c>
code uchar scan[] = {0xfe,0xfd,0xfb,0xf7,0xef,0xdf,0xbf,0x7f};		//列扫描
uint cp1,cp2,cp3;
code uchar dianzhen[10][8] = 
{  
	{0x00,0x1C,0x22,0x22,0x22,0x22,0x22,0x1C},						//0
	{0x00,0x08,0x18,0x08,0x08,0x08,0x08,0x3C},						//1
	{0x00,0x1C,0x02,0x02,0x1C,0x20,0x20,0x1C},						//2
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	{0x00,0x1C,0x22,0x22,0x1C,0x02,0x02,0x1C},						//9
};    																//0~9字符数组
/*********************定时器中断服务函数************************/
void timer0_isr(void) interrupt 1
{
	TH0 = (65535 - 2000) / 256;
	TL0 = (65535 - 2000) % 256;
	cp1++;if(cp1 >= 8)cp1 = 0;
	cp2++;
	if(cp2 > 500)													//1秒
	{
		cp2 =0;cp3++;
		if(cp3 >= 10)												//10秒
		cp3 = 0;
	}	
	send(dianzhen[cp3][cp1]);										//后发送8位列数据，与行扫描对应的列数据
	send(scan[cp1]);												//先发送行扫描
	suocun();														//行列控制器锁存输出，每帧图像显示时间为2毫秒
}
/*********************定时器中断初始化函数**********************/
void timer0_init(void)
{
	TMOD = 0x01;
	TH0 = (65535 - 2000) / 256;
	TL0 = (65535 - 2000) % 256;
	EA = 1;
	ET0 = 1;
	TR0 = 1;
}
/*************************主函数********************************/
void main(void)
{
	timer0_init();
	while(1);
}
